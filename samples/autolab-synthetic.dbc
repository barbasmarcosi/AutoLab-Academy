VERSION "AutoLab_Synthetic_V1"
NS_ :

BS_:
BU_: AUTO_LAB
BO_ 288 EngineState: 8 AUTO_LAB
 SG_ EngineRPM : 0|16@1+ (0.25,0) [0|16000] "rpm" AUTO_LAB
 SG_ RollingCounter : 16|8@1+ (1,0) [0|255] "" AUTO_LAB
BO_ 544 Temperature: 2 AUTO_LAB
 SG_ CoolantTemp : 0|8@1+ (1,-40) [-40|215] "degC" AUTO_LAB
